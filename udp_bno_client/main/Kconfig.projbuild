## udp_bno_client/main/Kconfig.projbuild
```kconfig
menu "Example Configuration"

config WIFI_SSID
    string "WiFi SSID"
	default "myssid"
	help
		SSID (network name) for the example to connect to.

config WIFI_PASSWORD
    string "WiFi Password"
	default "mypassword"
	help
		WiFi password (WPA or WPA2) for the example to use.
		Can be left blank if the network has no security set.

choice EXAMPLE_IP_MODE
    prompt "IP Version"
    help
       Example can use either IPV4 or IPV6.

config EXAMPLE_IPV4
    bool "IPV4"

config EXAMPLE_IPV6
   bool "IPV6"

endchoice

config EXAMPLE_IPV4_ADDR
    string "IPV4 Address"
    default "192.168.0.165"
    depends on EXAMPLE_IPV4
    help
       IPV4 address to which the client example will send data.

config EXAMPLE_IPV6_ADDR
    string "IPV6 Address"
    default "FE80::30AD:E57B:C212:68AD"
    depends on EXAMPLE_IPV6
    help
       IPV6 address to which the client example will send data.

config SEND_PORT
    int "Remote port"
    range 0 65535
    default 3333
    help
        The remote port to which the client example will send data.
        
config RECEIVE_PORT
    int "Device port"
    range 0 65535
    default 3333
    help
        The device port from which the client example will receive data.

choice EXAMPLE_I2C_PORT
    prompt "I2C Port"
    help
        Choose the port bno055 sensor is connected with

config EXAMPLE_I2C_PORT_0
    bool "Port 0"

config EXAMPLE_I2C_PORT_1
    bool "Port 1"

endchoice

choice EXTERNAL_CRYSTAL
    prompt "External crystal"
    help
        Choose to use external crystal on BNO for timing

config USE_CRYSTAL
    bool "Yes"

config NOT_USE_CRYSTAL
    bool "No"

endchoice


endmenu
```
